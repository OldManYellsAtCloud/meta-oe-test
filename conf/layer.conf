## conf/layer.conf
```bitbake
# We have a conf and classes directory, append to BBPATH
BBPATH .= ":${LAYERDIR}"

# We have a recipes directory, add to BBFILES
BBFILES += "${LAYERDIR}/recipes-*/*/*.bb ${LAYERDIR}/recipes-*/*/*.bbappend"

BBFILE_COLLECTIONS += "oe-test-layer"
BBFILE_PATTERN_oe-test-layer := "^${LAYERDIR}/"

LAYERVERSION_oe-test-layer = "2"
LAYERSERIES_COMPAT_oe-test-layer = "kirkstone scarthgap whinlatter"

LAYERDEPENDS_oe-test-layer = " \
    core \
    openembedded-layer \
    filesystems-layer \
    gnome-layer \
    meta-initramfs \
    multimedia-layer \
    networking-layer \
    perl-layer \
    meta-python \
    webserver \
    xfce-layer"
```
